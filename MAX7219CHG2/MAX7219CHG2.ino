
#include "LedControlMS.h"
#include <avr/pgmspace.h>

#define M_CLK    7
#define M_CS     6
#define M_DIN    5

LedControl lc = LedControl(M_DIN,M_CLK,M_CS,1);

const uint8_t heart[][8] PROGMEM =  {{0x00,0x00,0x00,0x00,0x00,0x00,0x00,0x00},
                                     {0x7e,0x7e,0x18,0x18,0x18,0x18,0x7e,0x7e},
                                     {0x7e,0x7e,0x18,0x18,0x18,0x18,0x7e,0x7e},
                                     {0x00,0x66,0xff,0xff,0x7e,0x3c,0x18,0x00},
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                                     {0xc3,0xc3,0xc3,0xc3,0xc3,0xc3,0x7e,0x3c}
                                     };
//uint8_t heart[] = {0x00,0xff,0x00,0xff,0x02,0x02,0x02,0x0};

const uint8_t font[] PROGMEM = {0x00, 0x00, 0x00, 0x00, 0x00,// (space)
                                0x00, 0x00, 0x5F, 0x00, 0x00,// !
                                0x00, 0x07, 0x00, 0x07, 0x00,// "
                                0x14, 0x7F, 0x14, 0x7F, 0x14,// #
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                                0x00, 0x00, 0x00, 0x00, 0x00 //   (code 255)
                                };
    
    
//const uint8_t txt_message1[] PROGMEM =  {" Congratulations! you have managed to complete the first phase of the Torbay TechJam mini matrix sign builder workshop at Paignton Library    "};

//const uint8_t txt_message1[] PROGMEM =  {" Welcome to the Paignton Library Tech Jam 9th April 2016. Sign up for our mini matrix sign building workshop and you could build a mini matrix sign like this one for £15.    "};

const uint8_t txt_message1[] PROGMEM =  {"   Welcome to the September Tech jam,  "};

//const uint8_t txt_message1[] PROGMEM =  {"   Sherwell  Valley  Primary  School - Digital   Leaders  Club,  "};

//const uint8_t txt_message1[] PROGMEM =  {"   Priory School - Year 4 - Computer project demonstration  "};


void bitmap(const uint8_t * ptr)
    {
    for(int row=0;row<8;row++)
        for(int col=0;col<8;col++)
          if(  (pgm_read_byte_near(ptr + row) & (128 >> col)) != 0)
               lc.setLed(0,col,7 - row,true);
          else
               lc.setLed(0,col,7 - row,false);
    }

void message(const uint8_t * ptr, const uint8_t * font, unsigned int tdelay)
    {
    uint8_t mcounter = 0;
    uint8_t mptr;
    uint8_t fptr;
    
    do
        {
        mptr = pgm_read_byte_near(ptr+mcounter);
        if(mptr != 0)
            {
            for(int fcounter=0;fcounter<5;fcounter++)
                {
                fptr = pgm_read_byte_near(font+((mptr-32)*5)+fcounter);
                for(int i=0;i<8;i++)
                    if((fptr & (128 >> i)) !=0)
                        lc.setLed(0,fcounter+1,i,true);
                    else
                        lc.setLed(0,fcounter+1,i,false);
                }
            }
        mcounter++;
        delay(tdelay); 
        }
        while(mptr !=0 );
    }
    
unsigned int calculate_length(const uint8_t * ptr)
    {
    unsigned int counter = 0;
    
    while(pgm_read_byte_near(ptr+counter) != 0)
        counter++;
        
    return(counter);
    }
    
void message_scroll(const uint8_t * ptr, const uint8_t * font, unsigned int tdelay)
    {
    uint8_t  mcounter = 0;
    uint8_t  mptr[3];
    uint8_t  fptr[15];
    
    unsigned int length = calculate_length(ptr); 
    unsigned int ccounter;
    
    for(ccounter=0;ccounter < (length - 1); ccounter++)
        {
          
        mptr[0] = pgm_read_byte_near(ptr+ccounter);
        mptr[1] = pgm_read_byte_near(ptr+((ccounter+1) % length));
        mptr[2] = pgm_read_byte_near(ptr+((ccounter+2) % length));
        
        for(int fcounter=0;fcounter<5;fcounter++)
            {
            fptr[fcounter]    = pgm_read_byte_near(font + ((mptr[0] - 32) * 5)+fcounter);
            fptr[fcounter+5]  = pgm_read_byte_near(font + ((mptr[1] - 32) * 5)+fcounter);
            fptr[fcounter+10] = pgm_read_byte_near(font + ((mptr[2] - 32) * 5)+fcounter);
            }
            
        for(int letter=0;letter<5;letter++)
            {    
            for(int fcounter=0;fcounter<8;fcounter++)
                {
                for(int i=0;i<8;i++)
                    if((fptr[fcounter + letter] & (128 >> i)) != 0)
                        lc.setLed(0,fcounter,i,true);
                    else
                        lc.setLed(0,fcounter,i,false);
                }
                    
            delay(tdelay);    
            } 
        }
    }

void setup()
    {
    // the zero refers to the MAX7219 number, it is zero for 1 chip
    lc.shutdown(0,false);// turn off power saving, enables display
    lc.setIntensity(0,1);// sets brightness (0~15 possible values)
    lc.clearDisplay(0);// clear screen
    
    for(int row=0;row<8;row++)
       for(int col=0;col<8;col++)
           lc.setLed(0,col,row,false);
    delay(2000);
    
    Serial.begin(9600);
    Serial.print("£\n");
    Serial.print('£',DEC);
    }

void loop()
    {
    message_scroll(txt_message1,font,60);
    }
